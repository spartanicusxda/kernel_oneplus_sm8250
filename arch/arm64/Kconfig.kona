## arch/arm64/Kconfig.kona
```kconfig
menu "SM8250 OP DTBO build"

config MACH_SM8250_OP_GLOBAL
	bool "Build DTBO image for kebab/lemonades"
	depends on ARCH_KONA && BUILD_ARM64_DT_OVERLAY
	default n
	help
	  Say Y here if you want to build DTBO image for OnePlus 8T/9R

endmenu # "SM8250 OP DTBO build"
```

## init/Kconfig.custom
```kconfig
menu "Custom configs"

config HAVE_CUSTOM_CONFIGS
        bool "Support for custom configs"
        default n

config ALWAYS_COMPILE_MKCOMPILE
        bool "Always compile mkcompile_h"
        depends on HAVE_CUSTOM_CONFIGS
        default n
        help
          Mainly used to update build timestamp on every build

endmenu # "Custom configs"
```
